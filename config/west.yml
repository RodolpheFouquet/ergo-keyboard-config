## config/west.yml
```yaml
manifest:
  remotes:
      # zmk official
    - name: zmkfirmware
      url-base: https://github.com/zmkfirmware
    - name: dsifry
      url-base: https://github.com/dsifry
    - name: urob
      url-base: https://github.com/urob
    - name: inorichi
      url-base: https://github.com/inorichi
  projects:
    - name: zmk
      remote: zmkfirmware
      revision: v0.3
      import: app/west.yml
    - name: nice-view-mod
      remote: dsifry 
      revision: main             
    - name: zmk-helpers
      remote: urob
      revision: v0.3
    - name: zmk-adaptive-key
      remote: urob
      revision: v0.3
    - name: zmk-auto-layer
      remote: urob
      revision: v0.3
    - name: zmk-leader-key
      remote: urob
      revision: v0.3
    - name: zmk-tri-state
      remote: urob
      revision: v0.3
    - name: zmk-pmw3610-driver
      remote: inorichi
      revision: main
  self:
    path: config
```
